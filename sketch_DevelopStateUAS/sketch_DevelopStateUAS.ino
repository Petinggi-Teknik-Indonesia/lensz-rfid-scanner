// ----------------- RC522 -----------------
// SDA/SS = GPIO 5
// SCK = GPIO 18
// MOSI = GPIO 23
// MISO = GPIO 19
// RST = GPIO 4
// 3.3V
// GND

// ----------------- OLED -----------------
// SDA = GPIO 21
// SCL = GPIO 22
// 3.3V
// GND

// ----------------- HW-479 -----------------
// Red = GPIO 25
// Green = GPIO 26
// Blue = GPIO 27
// GND

// ----------------- Passive Buzzer -----------------
// Positive = GPIO 14
// Negative = GND

// ----------------- Buttons -----------------
// SCAN = GPIO 12
// STATUS = GPIO 13


// ----------------- Libraries -----------------
#include <WiFi.h>               
#include <HTTPClient.h>         
#include <SPI.h>                
#include <MFRC522.h>            
#include <Wire.h>               
#include <Adafruit_GFX.h>       
#include <Adafruit_SSD1306.h>   
#include <ArduinoJson.h>    
#include <WiFiManager.h>

// ----------------- Wi-Fi -----------------
WiFiManager wifiManager;
const char* apSSID = "LENS'Z_By_OptikGembira";
const char* apPassword = "wandyanakbaik"; 

// ----------------- Server -----------------
const String serverURL = "https://api.wandy.web.id"; 

// ----------------- Pin Definitions -----------------
#define SS_PIN   5    
#define RST_PIN  4    
#define RGB_R_PIN 25
#define RGB_G_PIN 26
#define RGB_B_PIN 27
#define BUZZER_PIN 14
#define BTN_SCAN 12
#define BTN_STATUS 13
                        
// ----------------- OLED -----------------
#define SCREEN_WIDTH 128      
#define SCREEN_HEIGHT 64      
#define SCREEN_I2C_ADDR 0x3C  
Adafruit_SSD1306 display(SCREEN_WIDTH, SCREEN_HEIGHT, &Wire, -1); 

// ----------------- RFID -----------------
MFRC522 rfid(SS_PIN, RST_PIN);  

// ----------------- Timing -----------------
unsigned long lastButtonPress = 0;        
const unsigned long debounceDelay = 300;  
unsigned long lastActivityTime = 0;       

// ----------------- Mode -----------------
enum Mode { MODE_WELCOME, MODE_SCAN, MODE_STATUS }; 
Mode currentMode = MODE_WELCOME;
bool isSearchMode = false;

// ----------------- Status Control -----------------
String currentRFID = "";  
int statusIndex = 0;      
String statusList[5] = {"Tersedia", "Terjual", "Terpinjam", "Rusak", "Lainnya"};  

// ----------------- LED -----------------
void setLED(bool r, bool g, bool b) {       
  digitalWrite(RGB_R_PIN, r ? HIGH : LOW);  
  digitalWrite(RGB_G_PIN, g ? HIGH : LOW);  
  digitalWrite(RGB_B_PIN, b ? HIGH : LOW);  
}

// ----------------- Animation from Wokwi Style -----------------
#define FRAME_DELAY 42    
#define FRAME_WIDTH 48    
#define FRAME_HEIGHT 48   
#define FRAME_COUNT 27    

const byte PROGMEM frames[][288] = { 
  {0,0,0,0,0,0,0,0,0,0,0,0,0,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0,0},
  {0,0,0,0,0,0,0,0,0,0,0,0,0,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0,0},
  {0,0,0,0,0,0,0,0,0,0,0,0,0,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0,0},
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  {0,0,0,0,0,0,0,0,0,0,0,0,0,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0,0}
};

// ----------------- Animation Control Variables -----------------
bool loadingActive = false;
unsigned long lastFrameTime = 0;
int currentFrame = 0;

// ----------------- Loading Animation -----------------
void startLoadingAnimation() {
  loadingActive = true;
  currentFrame = 0;
  lastFrameTime = millis();
}

void stopLoadingAnimation() {
  loadingActive = false;
  display.clearDisplay();
  display.display();
}

void updateLoadingAnimation() {
  if (!loadingActive) return;
  if (millis() - lastFrameTime >= FRAME_DELAY) {
    display.clearDisplay();
    display.drawBitmap(40, 8, frames[currentFrame], FRAME_WIDTH, FRAME_HEIGHT, 1);
    display.display();
    currentFrame = (currentFrame + 1) % FRAME_COUNT;
    lastFrameTime = millis();
  }
}

// ----------------- Setup -----------------
void setup() {
  Serial.begin(115200);
  delay(100);

  pinMode(RGB_R_PIN, OUTPUT);         
  pinMode(RGB_G_PIN, OUTPUT);         
  pinMode(RGB_B_PIN, OUTPUT);         
  pinMode(BUZZER_PIN, OUTPUT);        
  pinMode(BTN_STATUS, INPUT_PULLUP);  
  pinMode(BTN_SCAN, INPUT_PULLUP);    
  setLED(0, 0, 0);                    

  if (!display.begin(SSD1306_SWITCHCAPVCC, SCREEN_I2C_ADDR)) {   
    Serial.println("OLED gagal diinisialisasi");  
    while (true);
  }

  display.setTextColor(SSD1306_WHITE);
  SPI.begin();      \
  rfid.PCD_Init(); 
  Serial.println("RC522 siap");


  // ----------------- WiFi Setup -----------------
  display.clearDisplay();
  display.setTextSize(1);
  display.setCursor(0, 10);
  display.println("Membuka AP WiFi...");
  display.display();  wifiManager.setConfigPortalTimeout(180);

  if (!wifiManager.autoConnect(apSSID, apPassword)) {
    Serial.println("Gagal koneksi WiFi. Restart ESP.");
    ESP.restart();
  }

  display.clearDisplay();
  display.setCursor(0, 20);
  display.println("WiFi Terhubung");
  display.setCursor(0, 30);
  display.println(WiFi.SSID());
  display.display();

  Serial.print("WiFi Terhubung: ");
  Serial.println(WiFi.SSID());
  Serial.print("IP: ");
  Serial.println(WiFi.localIP());

  delay(1000);
  showWelcomeScreen();
  lastActivityTime = millis();
}

// ----------------- UID to String -----------------
String uidToString(MFRC522::Uid &uid) {   
  String s = "";                          
  for (byte i = 0; i < uid.size; i++) {   
    if (uid.uidByte[i] < 0x10) s += "0";  
    s += String(uid.uidByte[i], HEX);     
  }
  s.toUpperCase(); 
  return s; 
}

// ----------------- Display Modes -----------------
void showWelcomeScreen() {
  currentMode = MODE_WELCOME;
  setLED(0, 0, 0);                            
  display.clearDisplay();                     
  display.setTextSize(1);                     
  display.setCursor(10, 20);                  
  display.println("Welcome to LENS'Z");
	display.setCursor(13, 30);              
  display.println("by Optik Gembira");
  display.display();                          
}

void showScanMode() {
  currentMode = MODE_SCAN;
  isSearchMode = false;
  setLED(0, 0, 1);
  display.clearDisplay();
  display.setCursor(0, 10);
  display.println("Mode: DAFTAR");
  display.setCursor(0, 40);
  display.println("Scan tag untuk daftar");
  display.display();
}

void showSearchMode() {
  currentMode = MODE_SCAN;
  isSearchMode = true;
  setLED(0, 0, 1);
  display.clearDisplay();
  display.setCursor(0, 10);
  display.println("Mode: SEARCH");
  display.setCursor(0, 40);
  display.println("Scan untuk mencari");
  display.display();
}

void showStatusMode() {
  currentMode = MODE_STATUS;
  setLED(0, 0, 1);                            
  display.clearDisplay();                     
  display.setTextSize(1);                     
  display.setCursor(0, 10);                   
  display.println("Mode: STATUS");
  display.setCursor(0, 25);
  display.println("Pilih status dulu");
  display.setCursor(0, 40);
  display.println("(Klik lagi)");
  display.display();                          
}

void showStatus(String status) {
  setLED(0, 0, 1);                            
  display.clearDisplay();                     
  display.setTextSize(1);                     
  display.setCursor(0, 10);                   
  display.print("Status: ");
  display.println(status);
  display.setCursor(0, 40);
  display.println("Scan tag untuk update");
  display.display();                          
}

// ----------------- HTTP -----------------
int sendPOST(String endpoint, String payload) {      
  if (WiFi.status() != WL_CONNECTED) return -1;          
  startLoadingAnimation();                            

  HTTPClient http;                                    
  String url = serverURL + endpoint;                  
  http.begin(url);                                    
  http.addHeader("Content-Type", "application/json"); 

  unsigned long start = millis();
  while (millis() - start < 2000) { updateLoadingAnimation(); delay(10); }

  int httpCode = http.POST(payload);
  String response = http.getString();

  stopLoadingAnimation();                             
  Serial.println("=== POST " + endpoint + " ===");    
  Serial.println("Payload: " + payload);              
  Serial.println("Kode: " + String(httpCode));        
  Serial.println("Resp: " + response);                
  http.end();                                         
  return httpCode;
}


int sendPATCH(String endpoint, String payload) {     
  if (WiFi.status() != WL_CONNECTED) return -1;
  startLoadingAnimation();

  HTTPClient http;
  String url = serverURL + endpoint;                  
  http.begin(url);                                    
  http.addHeader("Content-Type", "application/json");

  unsigned long start = millis();
  while (millis() - start < 2000) { updateLoadingAnimation(); delay(10); }

  int httpCode = http.sendRequest("PATCH", payload);
  String response = http.getString();

  stopLoadingAnimation();
  Serial.println("=== PATCH " + endpoint + " ===");
  Serial.println("Payload: " + payload);
  Serial.println("Kode: " + String(httpCode));
  Serial.println("Resp: " + response);
  http.end();                                         
  return httpCode;
}

// ----------------- Main Loop -----------------
void loop() {

  if (millis() - lastActivityTime > 10000 && currentMode != MODE_WELCOME) { 
    showWelcomeScreen();  
  }

  if (digitalRead(BTN_SCAN) == LOW && millis() - lastButtonPress > debounceDelay) {
    lastButtonPress = millis();
    lastActivityTime = millis();
    tone(BUZZER_PIN, 2000, 100);

    if (currentMode == MODE_SCAN && !isSearchMode ) {
      showSearchMode();
    } else {
      showScanMode();
    }
  }
  if (digitalRead(BTN_STATUS) == LOW && millis() - lastButtonPress > debounceDelay && currentMode != MODE_STATUS) { 
    lastButtonPress = millis();   
    lastActivityTime = millis();  
    tone(BUZZER_PIN, 2200, 100);  
    showStatusMode();             
  }

  if (currentMode == MODE_SCAN) {
    if (rfid.PICC_IsNewCardPresent() && rfid.PICC_ReadCardSerial()) {
      lastActivityTime = millis();
      tone(BUZZER_PIN, 2500, 150);
      String uid = uidToString(rfid.uid);

      StaticJsonDocument<128> doc;
      doc["rfid"] = uid;
      String jsonData;
      serializeJson(doc, jsonData);

      int code;
      if (!isSearchMode) {
        code = sendPOST("/scanner/scan", jsonData);
      } else {
        code = sendPOST("/scanner/search", jsonData);
      }

      display.clearDisplay();
      display.setCursor(0, 20);
      if (!isSearchMode) {
        if (code == 200) {
          setLED(0, 1, 0);
          display.println("ID Terkirim");
        } else if (code == 409) {
          setLED(1, 0, 0);
          display.println("Daftarkan ID");
          display.setCursor(0, 30);
          display.println("di aplikasi dulu");
        } else if (code == -1) {
          setLED(1, 0, 0);
          display.println("WiFi Terputus");
          display.setCursor(0, 30);
          display.println("Nyalakan ulang");
        } else {
          setLED(1, 0, 0);
          display.println("ID Gagal Terkirim");
        }
      } else {
        if (code == 200) {
          setLED(0, 1, 0);
          display.println("Data Ditemukan");
        } else if (code == 404) {
          setLED(1, 0, 0);
          display.println("Data Tidak Ada");
        } else if (code == -1) {
          setLED(1, 0, 0);
          display.println("WiFi Terputus");
          display.setCursor(0, 30);
          display.println("Nyalakan ulang");
        } else {
          setLED(1, 0, 0);
          display.println("Search Gagal");
        }
      }
      display.display();
      delay(1200);
      isSearchMode ? showSearchMode() : showScanMode();
      rfid.PICC_HaltA();
      rfid.PCD_StopCrypto1();
    }
  }

  if (currentMode == MODE_STATUS) { 
    if (digitalRead(BTN_STATUS) == LOW && millis() - lastButtonPress > debounceDelay) { 
      lastButtonPress = millis();
      lastActivityTime = millis();
      statusIndex = (statusIndex + 1) % 5;  
      tone(BUZZER_PIN, 2200, 100);
      showStatus(statusList[statusIndex]);  
    }

    if (rfid.PICC_IsNewCardPresent() && rfid.PICC_ReadCardSerial()) { 
      lastActivityTime = millis();        
      tone(BUZZER_PIN, 2500, 150);        
      String uid = uidToString(rfid.uid); 

      StaticJsonDocument<256> doc;  
      doc["rfid"] = uid;            
      doc["status"] = statusList[statusIndex];  
      String jsonData;
      serializeJson(doc, jsonData);

      int code = sendPATCH("/scanner/status", jsonData); 
      display.clearDisplay();
      display.setCursor(0, 20);

      if (code == 200) {
        setLED(0, 1, 0);
        display.println("Status Terkirim");
      } else if (code == 500) {
        setLED(1, 0, 0);
        display.println("ID Belum Terdaftar");
      } else if (code == -1) {
        setLED(1, 0, 0);
        display.println("WiFi Terputus");
        display.setCursor(0, 30);
        display.println("Nyalakan ulang");
      } else {
        setLED(1, 0, 0);
        display.println("Status Gagal Terkirim");
      }

      display.display();
      delay(1200);
      showStatus(statusList[statusIndex]);

      rfid.PICC_HaltA();
      rfid.PCD_StopCrypto1();
    }
  }
}
